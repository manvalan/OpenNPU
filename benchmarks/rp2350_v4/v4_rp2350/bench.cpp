// SPDX-FileCopyrightText: Copyright (c) 2026 Michele (manvalan)
// SPDX-License-Identifier: MIT
// Source location: https://github.com/manvalan/OpenNPU
// FPGA-Neural v4 -- the same network on the RP2350 CPU (Cortex-M33 or
// Hazard3 RISC-V), with the FPGA integer arithmetic: the RP2350 twin of
// ../esp32s3_v4/firmware/main/main.cpp. Same v4net.cpp (compiled in from
// ../esp32s3_v4/firmware/main via v4net_impl.cpp), same net.bin (linked
// by net_bin.S, generated by ../run_rp2350.sh), same serial output
// (one CSV line per run, a RESULT line), 10 runs, time_us_64().
#include <Arduino.h>
#include <cstring>
#include <string>
#include "v4net.hpp"

extern "C" const uint8_t net_bin_start[];
extern "C" const uint8_t net_bin_end[];

static constexpr int RUNS = 10;

static void *alloc_report(size_t n)
{
    void *p = malloc(n);
    if (!p) {   // no PSRAM: the network does not fit the internal SRAM
        Serial.printf("E v4_rp2350: out of memory: %u bytes requested, heap free %u\n",
                      (unsigned)n, (unsigned)(rp2040.getFreeHeap()));
        Serial.flush();
        while (true) delay(1000);
    }
    return p;
}

void setup()
{
    Serial.begin(115200);
    while (!Serial) delay(10);
    delay(500);
    v4net::Net::alloc = alloc_report;
    v4net::Net::release = free;
    v4net::Net net;
    std::string err;
    const size_t blob_len = net_bin_end - net_bin_start;
    Serial.printf("I v4_rp2350: chip RP2350 %s, CPU %lu MHz, free heap %u, PSRAM %u, net.bin read in place from flash\n",
#if defined(__riscv)
                  "RISC-V",
#else
                  "ARM",
#endif
                  (unsigned long)(rp2040.f_cpu() / 1000000), (unsigned)rp2040.getFreeHeap(),
                  (unsigned)rp2040.getPSRAMSize());
    if (!net.load(net_bin_start, blob_len, err)) {
        Serial.printf("E v4_rp2350: net.bin: %s\n", err.c_str());
        return;
    }
    Serial.printf("I v4_rp2350: network: %u layers, output %u values, %u bytes of net.bin\n",
                  (unsigned)net.layers(), (unsigned)net.expected_len(), (unsigned)blob_len);
    uint64_t best = UINT64_MAX, total = 0;
    int bad = 0;
    for (int r = 0; r < RUNS; r++) {
        uint64_t t0 = time_us_64();
        const v4net::Tensor &y = net.run();
        uint64_t us = time_us_64() - t0;
        total += us;
        if (us < best) best = us;
        bool ok = y.size() == net.expected_len() && std::memcmp(y.d, net.expected(), y.size()) == 0;
        if (!ok) bad++;
        Serial.printf("I v4_rp2350: run %d: %.3f ms, output %s\n", r, us / 1000.0, ok ? "identical to the FPGA" : "DIFFERENT");
        Serial.printf("CSV,%d,%llu,%d\n", r, (unsigned long long)us, ok ? 1 : 0);
    }
    Serial.printf("I v4_rp2350: RESULT: best %.3f ms, mean %.3f ms over %d runs, %d/%d bit-exact, peak activations %u bytes\n",
                  best / 1000.0, total / 1000.0 / RUNS, RUNS, RUNS - bad, RUNS, (unsigned)net.peak_bytes());
}

void loop() { delay(1000); }
